## components/mqtt_manager/Kconfig
```kconfig
menu "MQTT Manager Configuration"

    config MQTT_ENDPOINT
        string "MQTT Endpoint"
        default "mqtt.lygoiq.com"
        help
            This defines the MQTT endpoint used for MQTT.

    config MQTT_ENDPOINT_PORT
        int "MQTT Endpoint PORT"
        default 8883
        help
            This defines the MQTT endpoint port used for MQTT.
    
    
    
    endmenu
    
```

## components/nvs_manager/kconfig
```kconfig
menu "NVS Manager Configuration"

config NVS_NAMESPACE
    string "NVS Storage Namespace"
    default "storage"
    help
        This defines the namespace used for storing data in NVS.
config WIFI_NAMESPACE
    string "WIFI_CONFIG NVS Storage Namespace"
    default "wifi_config"
    help
        This defines the namespace used for WIFI_CONFIG (ssid, passwod) in NVS.
config DEVICE_DATA_NAMESPACE
    string "DEVICE_DATA NVS Storage Namespace"
    default "device_data"
    help
        This defines the namespace used for DEVICE_DATA in NVS.
config NVS_MAX_STRING_LENGTH
    int "Maximum String Length"
    default 2048
    range 1 4096
    help
        Defines the maximum length of strings that can be stored in NVS.

endmenu
```

## components/smart_board_core/kconfig
```kconfig
menu "WIFI Switch Manager Configuration"


    
config REST_SWITCH
    int "set the rest switch"
    default 2
    range 1 10
    help
        Defines the rest switch for restarting the device.

config TIME_FOR_REST_SWITCH
    int "set the time rest switch in sec"
    default 5
    range 1 1000
    help
        Defines the time rest switch for restarting the device.

config MIN_DELAY_AWAY_MODE
    int "min delay in sec"
    default 3600
    range 1 999999
    help
        Defines the minimum delay for away mode.
config MAX_DELAY_AWAY_MODE
    int "max delay in sec"
    default 10800
    range 1 999999
    help
        Defines the maximum delay for away mode.

config FIRMWARE_VERSION
    string "firmware version"
    default "1.2.0"
    help
        Defines the firmware version.
config API_VERSION
    string "api version"
    default "1.0.0"
    help
        Defines the api version for the cloud.

endmenu
```
